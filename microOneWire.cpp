#include "microOneWire.h"
#define MOW_CLI()  // Отключаем прерывания
#define MOW_SEI()  // Включаем прерывания
// Примечание: Отключение прерываний нужно для точности временных задержек в протоколе OneWire. Это предотвращает сбои в передаче данных, гарантируя, что важные операции выполняются без задержек от прерываний.

// Функция для отправки команды сброса (reset) устройству на шине OneWire
bool oneWire_reset(uint8_t pin) {
  // Устанавливаем пин в режим OUTPUT, чтобы послать импульс сброса (600 мкс)
  pinMode(pin, OUTPUT);
  delayMicroseconds(600);  // Удерживаем линию в низком состоянии

  // Устанавливаем пин в режим INPUT, чтобы дать устройству возможность ответить
  pinMode(pin, INPUT);
  // MOW_CLI();  // Отключаем прерывания для точного измерения времени

  // Ждем 60 мкс и проверяем наличие импульса присутствия
  delayMicroseconds(60);          // Даем устройству возможность ответить
  bool pulse = digitalRead(pin);  // Считываем ответ устройства

  // MOW_SEI();  // Включаем прерывания
  delayMicroseconds(600);  // Ждем до окончания окна ожидания

  // Если устройство ответило (низкий уровень на линии), возвращаем true
  return !pulse;
}

// Функция записи байта данных на шину OneWire
void oneWire_write(uint8_t data, uint8_t pin) {
  for (uint8_t i = 8; i; i--) {  // Цикл для записи 8 бит (байта данных)
    // Устанавливаем пин в режим OUTPUT, чтобы отправить бит
    pinMode(pin, OUTPUT);
    // MOW_CLI();  // Отключаем прерывания

    // Если младший бит равен 1, отправляем короткий импульс низкого уровня
    if (data & 1) {
      delayMicroseconds(5);   // Низкий уровень в течение 5 мкс
      pinMode(pin, INPUT);    // Устанавливаем пин в режим INPUT (отпускаем линию)
      delayMicroseconds(60);  // Ждем 60 мкс
    } else {
      // Если бит равен 0, удерживаем линию низкой дольше (60 мкс)
      delayMicroseconds(60);  // Держим низкий уровень в течение 60 мкс
      pinMode(pin, INPUT);    // Устанавливаем пин в режим INPUT
      delayMicroseconds(5);   // Ждем 5 мкс перед следующим битом
    }

    // MOW_SEI();  // Включаем прерывания
    data >>= 1;  // Сдвигаем данные вправо, чтобы отправить следующий бит
  }
}

// Функция чтения байта данных с шины OneWire
uint8_t oneWire_read(uint8_t pin) {
  uint8_t data = 0;  // Переменная для хранения считанных данных

  for (uint8_t i = 8; i; i--) {  // Цикл для чтения 8 бит (байта данных)
    data >>= 1;                  // Сдвигаем данные вправо для хранения каждого нового бита
    // MOW_CLI();  // Отключаем прерывания

    // Устанавливаем пин в режим OUTPUT, чтобы отправить команду чтения
    pinMode(pin, OUTPUT);
    delayMicroseconds(2);  // Удерживаем низкий уровень в течение 2 мкс

    // Устанавливаем пин в режим INPUT, чтобы считать бит данных
    pinMode(pin, INPUT);
    delayMicroseconds(8);  // Ждем 8 мкс для того, чтобы устройство передало бит данных

    // Если линия высокая, то бит данных равен 1, иначе 0
    if (digitalRead(pin)) data |= (1 << 7);  // Если считан высокий уровень, записываем 1 в старший бит

    delayMicroseconds(60);  // Ждем до окончания времени слота чтения
    // MOW_SEI();  // Включаем прерывания
  }

  return data;  // Возвращаем считанный байт
}
